/*
 * pp_screen_painter.c
 *
 *  Created on: Oct 16, 2026
 *      Author: daniel_papa
 */

#include "pp_screen_painter.h"
#include <stddef.h>

#define LCD_W    800U
#define LCD_H    480U

#define COLOR_BLACK 0xFF000000
#define COLOR_WHITE 0xFFFFFFFF

#define FONT_FIRST_CHAR 0x20U
#define FONT_LAST_CHAR  0x7EU
#define FONT_WIDTH     8U
#define FONT_HEIGHT    8U

/* Printable ASCII, indexed by character - FONT_FIRST_CHAR.
   Each glyph is eight rows, top to bottom. Bit 7 is the leftmost pixel;
   a set bit draws the foreground color, a clear bit leaves the background.
   Most glyphs use a 5x7 drawing inside their fixed 8x8 character cell. */
static const uint8_t font8x8[FONT_LAST_CHAR - FONT_FIRST_CHAR + 1U][FONT_HEIGHT] = {
  {0x00,0x00,0x00,0x00,0x00,0x00,0x00,0x00}, /* 0x20 space */
  {0x10,0x10,0x10,0x10,0x10,0x00,0x10,0x00}, /* 0x21 ! */
  {0x28,0x28,0x28,0x00,0x00,0x00,0x00,0x00}, /* 0x22 double quote */
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  {0x00,0x00,0x24,0x58,0x00,0x00,0x00,0x00}, /* 0x7E ~ */
};




void paint_all_black(uint32_t * const sdram_ptr) {
  for (uint32_t y = 0; y < LCD_H; y++)
  {
	for (uint32_t x = 0; x < LCD_W; x++)
	{
	  sdram_ptr[y * LCD_W + x] = COLOR_BLACK;
	}
  }
}


void paint_dot(uint32_t * const sdram_ptr, uint16_t x_pos, uint16_t y_pos) {

  if(x_pos >= LCD_W || y_pos >= LCD_H) {
    return;
  }

  sdram_ptr[y_pos * LCD_W + x_pos] = COLOR_WHITE;

}

void put_dot(uint32_t * const sdram_ptr, uint16_t x_pos, uint16_t y_pos, uint16_t diam, uint32_t color) {

  if(x_pos >= LCD_W || y_pos >= LCD_H) {
    return;
  }

  // put the new dot with the specified diameter
  for (uint16_t dy = 0; dy < diam; dy++) {
    for (uint16_t dx = 0; dx < diam; dx++) {
      uint16_t px = x_pos + dx;
      uint16_t py = y_pos + dy;
      if (px < LCD_W && py < LCD_H) {
        sdram_ptr[py * LCD_W + px] = color;
      }
    }
  }

}

void move_dot(uint32_t * const sdram_ptr, uint16_t new_x, uint16_t new_y, uint32_t color) {
  static uint16_t last_x = 0xFFFF;
  static uint16_t last_y = 0xFFFF;

  if(last_x < LCD_W && last_y < LCD_H) {
    put_dot(sdram_ptr, last_x, last_y, 20, COLOR_BLACK);
  }

  put_dot(sdram_ptr, new_x, new_y, 20, color);
  last_x = new_x;
  last_y = new_y;

}


void put_char(volatile uint32_t * const sdram_ptr, uint16_t x_pos,
              uint16_t y_pos, char c, uint32_t color) {
  put_char_scaled(sdram_ptr, x_pos, y_pos, c, color, 1U);
}


void put_char_scaled(volatile uint32_t * const sdram_ptr, uint16_t x_pos,
                     uint16_t y_pos, char c, uint32_t color, uint8_t scale) {
  if (sdram_ptr == NULL || scale == 0U || x_pos >= LCD_W || y_pos >= LCD_H) {
    return;
  }

  uint8_t character = (uint8_t)c;
  if (character < FONT_FIRST_CHAR || character > FONT_LAST_CHAR) {
    character = (uint8_t)'?';
  }
  const uint8_t *glyph = font8x8[character - FONT_FIRST_CHAR];

  for (uint32_t row = 0U; row < FONT_HEIGHT; row++) {
    const uint32_t y = (uint32_t)y_pos + row * scale;
    if (y >= LCD_H) {
      break;
    }

    for (uint32_t column = 0U; column < FONT_WIDTH; column++) {
      const uint32_t x = (uint32_t)x_pos + column * scale;
      if (x >= LCD_W) {
        break;
      }
      if ((glyph[row] & (0x80U >> column)) == 0U) {
        continue;
      }

      /* Enlarge each lit font pixel into a scale-by-scale square. Use 32-bit
         coordinates so clipping also works for large positions and scales. */
      for (uint32_t dy = 0U; dy < scale && y + dy < LCD_H; dy++) {
        volatile uint32_t *destination = &sdram_ptr[(y + dy) * LCD_W + x];
        for (uint32_t dx = 0U; dx < scale && x + dx < LCD_W; dx++) {
          destination[dx] = color;
        }
      }
    }
  }
}
